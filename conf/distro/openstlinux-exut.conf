## conf/distro/openstlinux-exut.conf
```bitbake
require conf/distro/openstlinux-eglfs.conf

DISTRO_FEATURES_remove = " usbgadget "
DISTRO_FEATURES_append = " smbfs "
```

## conf/layer.conf
```bitbake
# We have a conf and classes directory, add to BBPATH
BBPATH .= ":${LAYERDIR}"

# We have recipes-* directories, add to BBFILES
BBFILES += "${LAYERDIR}/recipes-*/*/*.bb \
            ${LAYERDIR}/recipes-*/*/*.bbappend"

BBFILE_COLLECTIONS += "meta-exut"
BBFILE_PATTERN_meta-exut = "^${LAYERDIR}/"
BBFILE_PRIORITY_meta-exut = "4"

LAYERDEPENDS_meta-exut = "core"
LAYERSERIES_COMPAT_meta-exut = "thud"
```
